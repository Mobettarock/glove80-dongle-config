/*
 * Copyright (c) 2020 The ZMK Contributors
 * Copyright (c) 2025 Innaworks Development Limited, trading as MoErgo
 *
 * SPDX-License-Identifier: MIT
 */


/* THIS FILE WAS GENERATED BY GLOVE80 LAYOUT EDITOR
 *
 * This file was generated automatically. You may or may not want to
 * edit it directly.
 */

#include <behaviors.dtsi>
/* Include all behavior includes needed */
#include <dt-bindings/zmk/outputs.h>
#include <dt-bindings/zmk/keys.h>
#include <dt-bindings/zmk/bt.h>
#include <dt-bindings/zmk/rgb.h>

/* On demand includes */
#include <dt-bindings/zmk/input_transform.h>
#include <dt-bindings/zmk/pointing.h>
#include <input/processors.dtsi>

/* Helper Macros, based on https://github.com/urob/zmk-helpers/ */

#pragma once

#define ZMK_HELPER_STRINGIFY(x) #x

// Preprocessor mechanism to overload macros, cf. https://stackoverflow.com/a/27051616/6114651
#define VARGS_(_10, _9, _8, _7, _6, _5, _4, _3, _2, _1, N, ...) N
#define VARGS(...) VARGS_(__VA_ARGS__, 10, 9, 8, 7, 6, 5, 4, 3, 2, 1, 0)
#define CONCAT_(a, b) a##b
#define CONCAT(a, b) CONCAT_(a, b)

#define ZMK_BEHAVIOR_CORE_tap_dance  \
    compatible = "zmk,behavior-tap-dance"; \
    #binding-cells = <0>

#define ZMK_BEHAVIOR(name, type, ...) \
    name: name { \
        ZMK_BEHAVIOR_CORE_ ## type; \
        __VA_ARGS__ \
    };

#define ZMK_TAP_DANCE(name, ...) \
    ZMK_BEHAVIOR(name, tap_dance, __VA_ARGS__)

#define ZMK_TD_LAYER(name, layer) \
    ZMK_TAP_DANCE(name, \
        tapping-term-ms = <200>; \
        bindings = <&mo layer>, <&to layer>; \
)

/* Environment and metadata defines */
#define KB_TYPE_GLOVE_80 1
#define KB_TYPE_GO_60    2

#define KB_TYPE          KB_TYPE_GLOVE_80
#define EDITOR_HOST_OS   'L'

/* Automatically generated layer name defines */
#define LAYER_Main_w_hrm 0
#define LAYER_Numbers 1
#define LAYER_Symbol 2
#define LAYER_Mouse 3
#define LAYER_Fkey 4
#define LAYER_PgUpDwn 5
#define LAYER_Cursor_right_hand 6
#define LAYER_Cursor 7
#define LAYER_Cursor_outlook 8
#define LAYER_Cursor_onenote 9
#define LAYER_Cursor_excel 10
#define LAYER_MouseFast 11
#define LAYER_MouseSlow 12
#define LAYER_MouseWarp 13
#define LAYER_Cursor_shift 14
#define LAYER_LB01_copy_paste_and_excel 15
#define LAYER_LB02_l 16
#define LAYER_LB03 17
#define LAYER_Lower 18
#define LAYER_Magic 19
#define LAYER_Left_middle_hrm 20
#define LAYER_LB03_LB02 21
#define LAYER_LB04_LB03 22
#define LAYER_LB04 23
#define LAYER_Punctuation 24

/* To deal with the situation where there is no Lower layer, to keep &lower happy */
#ifndef LAYER_Lower
#define LAYER_Lower 0
#endif

/* Custom Device-tree */


/* Input Listeners */
&mmv_input_listener {
    // LAYER_MouseSlow
    LAYER_MouseSlow {
        layers = <LAYER_MouseSlow>;
        input-processors = <&zip_xy_scaler 1 9>;
    };
    // LAYER_MouseFast
    LAYER_MouseFast {
        layers = <LAYER_MouseFast>;
        input-processors = <&zip_xy_scaler 3 1>;
    };
    // LAYER_MouseFast
    LAYER_MouseWarp {
        layers = <LAYER_MouseWarp>;
        input-processors = <&zip_xy_scaler 12 1>;
    };
};

&msc_input_listener {
    // LAYER_MouseSlow
    LAYER_MouseSlow {
        layers = <LAYER_MouseSlow>;
        input-processors = <&zip_scroll_scaler 1 2>;
    };
    // LAYER_MouseFast
    LAYER_MouseFast {
        layers = <LAYER_MouseFast>;
        input-processors = <&zip_scroll_scaler 3 1>;
    };
    // LAYER_MouseWarp
    LAYER_MouseWarp {
        layers = <LAYER_MouseWarp>;
        input-processors = <&zip_scroll_scaler 12 1>;
    };
};

/* System behavior and Macros */
/ {
    behaviors {
        ZMK_TD_LAYER(lower, LAYER_Lower)
    };
};

/ {
    macros {
        rgb_ug_status_macro: rgb_ug_status_macro {
            label = "RGB_UG_STATUS";
            compatible = "zmk,behavior-macro";
            #binding-cells = <0>;
            bindings
                = <&rgb_ug RGB_STATUS>;
        };
    };
};


/ {
#ifdef BT_DISC_CMD
    behaviors {
        bt_0: bt_0 {
            compatible = "zmk,behavior-tap-dance";
            label = "BT_0";
            #binding-cells = <0>;
            tapping-term-ms = <200>;
            bindings = <&bt_select_0>, <&bt BT_DISC 0>;
        };
        bt_1: bt_1 {
            compatible = "zmk,behavior-tap-dance";
            label = "BT_1";
            #binding-cells = <0>;
            tapping-term-ms = <200>;
            bindings = <&bt_select_1>, <&bt BT_DISC 1>;
        };
        bt_2: bt_2 {
            compatible = "zmk,behavior-tap-dance";
            label = "BT_2";
            #binding-cells = <0>;
            tapping-term-ms = <200>;
            bindings = <&bt_select_2>, <&bt BT_DISC 2>;
        };
        bt_3: bt_3 {
            compatible = "zmk,behavior-tap-dance";
            label = "BT_3";
            #binding-cells = <0>;
            tapping-term-ms = <200>;
            bindings = <&bt_select_3>, <&bt BT_DISC 3>;
        };
    };
    macros {
        bt_select_0: bt_select_0 {
            label = "BT_SELECT_0";
            compatible = "zmk,behavior-macro";
            #binding-cells = <0>;
            bindings
                = <&out OUT_BLE>,
                  <&bt BT_SEL 0>;
        };
        bt_select_1: bt_select_1 {
            label = "BT_SELECT_1";
            compatible = "zmk,behavior-macro";
            #binding-cells = <0>;
            bindings
                = <&out OUT_BLE>,
                  <&bt BT_SEL 1>;
        };
        bt_select_2: bt_select_2 {
            label = "BT_SELECT_2";
            compatible = "zmk,behavior-macro";
            #binding-cells = <0>;
            bindings
                = <&out OUT_BLE>,
                  <&bt BT_SEL 2>;
        };
        bt_select_3: bt_select_3 {
            label = "BT_SELECT_3";
            compatible = "zmk,behavior-macro";
            #binding-cells = <0>;
            bindings
                = <&out OUT_BLE>,
                  <&bt BT_SEL 3>;
        };
    };
#else
    macros {
        bt_0: bt_0 {
            label = "BT_0";
            compatible = "zmk,behavior-macro";
            #binding-cells = <0>;
            bindings
                = <&out OUT_BLE>,
                  <&bt BT_SEL 0>;
        };
        bt_1: bt_1 {
            label = "BT_1";
            compatible = "zmk,behavior-macro";
            #binding-cells = <0>;
            bindings
                = <&out OUT_BLE>,
                  <&bt BT_SEL 1>;
        };
        bt_2: bt_2 {
            label = "BT_2";
            compatible = "zmk,behavior-macro";
            #binding-cells = <0>;
            bindings
                = <&out OUT_BLE>,
                  <&bt BT_SEL 2>;
        };
        bt_3: bt_3 {
            label = "BT_3";
            compatible = "zmk,behavior-macro";
            #binding-cells = <0>;
            bindings
                = <&out OUT_BLE>,
                  <&bt BT_SEL 3>;
        };
    };
#endif
};

/ {
    behaviors {
        magic: magic {
            compatible = "zmk,behavior-hold-tap";
            label = "MAGIC_HOLD_TAP";
            #binding-cells = <2>;
            flavor = "tap-preferred";
            tapping-term-ms = <200>;
            bindings = <&mo>, <&rgb_ug_status_macro>;
        };
    };
};


/* Key positions */

#define POS_LH_C6R1 0
#define POS_LH_C5R1 1
#define POS_LH_C4R1 2
#define POS_LH_C3R1 3
#define POS_LH_C2R1 4
#define POS_RH_C2R1 5
#define POS_RH_C3R1 6
#define POS_RH_C4R1 7
#define POS_RH_C5R1 8
#define POS_RH_C6R1 9
#define POS_LH_C6R2 10
#define POS_LH_C5R2 11
#define POS_LH_C4R2 12
#define POS_LH_C3R2 13
#define POS_LH_C2R2 14
#define POS_LH_C1R2 15
#define POS_RH_C1R2 16
#define POS_RH_C2R2 17
#define POS_RH_C3R2 18
#define POS_RH_C4R2 19
#define POS_RH_C5R2 20
#define POS_RH_C6R2 21
#define POS_LH_C6R3 22
#define POS_LH_C5R3 23
#define POS_LH_C4R3 24
#define POS_LH_C3R3 25
#define POS_LH_C2R3 26
#define POS_LH_C1R3 27
#define POS_RH_C1R3 28
#define POS_RH_C2R3 29
#define POS_RH_C3R3 30
#define POS_RH_C4R3 31
#define POS_RH_C5R3 32
#define POS_RH_C6R3 33
#define POS_LH_C6R4 34
#define POS_LH_C5R4 35
#define POS_LH_C4R4 36
#define POS_LH_C3R4 37
#define POS_LH_C2R4 38
#define POS_LH_C1R4 39
#define POS_RH_C1R4 40
#define POS_RH_C2R4 41
#define POS_RH_C3R4 42
#define POS_RH_C4R4 43
#define POS_RH_C5R4 44
#define POS_RH_C6R4 45
#define POS_LH_C6R5 46
#define POS_LH_C5R5 47
#define POS_LH_C4R5 48
#define POS_LH_C3R5 49
#define POS_LH_C2R5 50
#define POS_LH_C1R5 51
#define POS_LH_T1 52
#define POS_LH_T2 53
#define POS_LH_T3 54
#define POS_RH_T3 55
#define POS_RH_T2 56
#define POS_RH_T1 57
#define POS_RH_C1R5 58
#define POS_RH_C2R5 59
#define POS_RH_C3R5 60
#define POS_RH_C4R5 61
#define POS_RH_C5R5 62
#define POS_RH_C6R5 63
#define POS_LH_C6R6 64
#define POS_LH_C5R6 65
#define POS_LH_C4R6 66
#define POS_LH_C3R6 67
#define POS_LH_C2R6 68
#define POS_LH_T4 69
#define POS_LH_T5 70
#define POS_LH_T6 71
#define POS_RH_T6 72
#define POS_RH_T5 73
#define POS_RH_T4 74
#define POS_RH_C2R6 75
#define POS_RH_C3R6 76
#define POS_RH_C4R6 77
#define POS_RH_C5R6 78
#define POS_RH_C6R6 79


/* Custom Defined Behaviors */
/ {
// ==========================================
// BEHAVIORS (Place these nodes INSIDE your main 'behaviors' block)
// ==========================================
behaviors {

    // ==========================================
    // BACKSPACE / SHIFT-BACKSPACE -> DELETE
    // ==========================================
    bspc_del_shift: bspc_del_shift {
        compatible = "zmk,behavior-mod-morph";
        #binding-cells = <0>;
        bindings = <&kp BSPC>, <&kp DEL>;
        mods = <(MOD_LSFT|MOD_RSFT)>;
    };

    // ==========================================
    // ACTIVE NUMBERS LAYER MORPHS
    // ==========================================

    n0_eq: n0_eq {
        compatible = "zmk,behavior-mod-morph";
        #binding-cells = <0>;
        bindings = <&kp N0>, <&kp EQUAL>;
        mods = <(MOD_LSFT|MOD_RSFT)>;
    };

    n1_rpar: n1_rpar {
        compatible = "zmk,behavior-mod-morph";
        #binding-cells = <0>;
        bindings = <&kp N1>, <&kp RPAR>;
        mods = <(MOD_LSFT|MOD_RSFT)>;
    };

    n2_lpar: n2_lpar {
        compatible = "zmk,behavior-mod-morph";
        #binding-cells = <0>;
        bindings = <&kp N2>, <&kp LPAR>;
        mods = <(MOD_LSFT|MOD_RSFT)>;
    };

    n3_dlr: n3_dlr {
        compatible = "zmk,behavior-mod-morph";
        #binding-cells = <0>;
        bindings = <&kp N3>, <&kp DLLR>;
        mods = <(MOD_LSFT|MOD_RSFT)>;
    };

    n4_prcnt: n4_prcnt {
        compatible = "zmk,behavior-mod-morph";
        #binding-cells = <0>;
        bindings = <&kp N4>, <&kp PRCNT>;
        mods = <(MOD_LSFT|MOD_RSFT)>;
    };

    n5_quote: n5_quote {
        compatible = "zmk,behavior-mod-morph";
        #binding-cells = <0>;
        bindings = <&kp N5>, <&kp DQT>;
        mods = <(MOD_LSFT|MOD_RSFT)>;
    };

    n6_hash: n6_hash {
        compatible = "zmk,behavior-mod-morph";
        #binding-cells = <0>;
        bindings = <&kp N6>, <&kp HASH>;
        mods = <(MOD_LSFT|MOD_RSFT)>;
    };

    n7_lbkt: n7_lbkt {
        compatible = "zmk,behavior-mod-morph";
        #binding-cells = <0>;
        bindings = <&kp N7>, <&kp LBKT>;
        mods = <(MOD_LSFT|MOD_RSFT)>;
    };

    n8_amps: n8_amps {
        compatible = "zmk,behavior-mod-morph";
        #binding-cells = <0>;
        bindings = <&kp N8>, <&kp AMPS>;
        mods = <(MOD_LSFT|MOD_RSFT)>;
    };

    minus_slash: minus_slash {
        compatible = "zmk,behavior-mod-morph";
        #binding-cells = <0>;
        bindings = <&kp MINUS>, <&kp FSLH>;
        mods = <(MOD_LSFT|MOD_RSFT)>;
    };

    // ==========================================
    // ACTIVE BASE & PUNCTUATION MORPHS
    // ==========================================

    period_exclam: period_exclam {
        compatible = "zmk,behavior-mod-morph";
        #binding-cells = <0>;
        bindings = <&kp DOT>, <&kp EXCL>;
        mods = <(MOD_LSFT|MOD_RSFT)>;
    };

    comma_ques: comma_ques {
        compatible = "zmk,behavior-mod-morph";
        #binding-cells = <0>;
        bindings = <&kp COMMA>, <&kp QMARK>;
        mods = <(MOD_LSFT|MOD_RSFT)>;
    };

    qmark_excl: qmark_excl {
        compatible = "zmk,behavior-mod-morph";
        #binding-cells = <0>;
        bindings = <&kp QMARK>, <&kp EXCL>;
        mods = <(MOD_LSFT|MOD_RSFT)>;
    };

    under_minus: under_minus {
        compatible = "zmk,behavior-mod-morph";
        #binding-cells = <0>;
        bindings = <&kp UNDER>, <&kp MINUS>;
        mods = <(MOD_LSFT|MOD_RSFT)>;
    };

    // ==========================================
    // ACTIVE HOME ROW MOD (Right Pinky)
    // ==========================================

    hrm_rp_base: hrm_rp_base {
        compatible = "zmk,behavior-hold-tap";
        #binding-cells = <2>;
        flavor = "balanced";
        tapping-term-ms = <250>;
        quick-tap-ms = <175>;
        require-prior-idle-ms = <150>;
        bindings = <&kp>, <&kp>; 
    };

    slash_amps_hrm: slash_amps_hrm {
        compatible = "zmk,behavior-mod-morph";
        #binding-cells = <0>;
        bindings = <&hrm_rp_base RGUI SLASH>, <&hrm_rp_base RGUI AMPS>;
        mods = <(MOD_LSFT|MOD_RSFT)>;
    };
};

};

/* Generated input processors */


/* Automatically generated macro definitions */
/ {
    macros {

        // AutoShift Helper- &AS main macro is chained to &AS_HT hold tap and &AS_Shifted macro - TailorKey
        AS_Shifted_v1_TKZ: AS_Shifted_v1_TKZ {
            label = "&AS_SHIFTED_V1_TKZ";
            compatible = "zmk,behavior-macro-one-param";
            #binding-cells = <1>;
            bindings = <&macro_press>
                , <&kp LSHFT>
                , <&macro_tap>
                , <&macro_param_1to1>
                , <&kp N1>
                , <&macro_release>
                , <&kp LSHFT>;
        };

        // AutoShift (Assign &AS to a Key) - &AS main macro is chained to &AS_HT hold tap and &AS_Shifted macro - TailorKey
        AS_v1_TKZ: AS_v1_TKZ {
            label = "&AS_V1_TKZ";
            compatible = "zmk,behavior-macro-one-param";
            #binding-cells = <1>;
            tap-ms = <10>;
            wait-ms = <10>;
            bindings = <&macro_press>
                , <&macro_param_1to1>
                , <&macro_param_1to2>
                , <&AS_HT_v2_TKZ A A>
                , <&macro_pause_for_release>
                , <&macro_release>
                , <&macro_param_1to1>
                , <&macro_param_1to2>
                , <&AS_HT_v2_TKZ A A>;
        };

        // Cursor Layer - Select Line (seq) - TailorKey
        cur_SELECT_LINE_v1_TKZ: cur_SELECT_LINE_v1_TKZ {
            label = "&CUR_SELECT_LINE_V1_TKZ";
            compatible = "zmk,behavior-macro";
            #binding-cells = <0>;
            tap-ms = <1>;
            wait-ms = <1>;
            bindings = <&kp HOME>
                , <&kp LS(END)>;
        };

        // Cursor Layer - Select None (seq) - TailorKey
        cur_SELECT_NONE_v1_TKZ: cur_SELECT_NONE_v1_TKZ {
            label = "&CUR_SELECT_NONE_V1_TKZ";
            compatible = "zmk,behavior-macro";
            #binding-cells = <0>;
            tap-ms = <1>;
            wait-ms = <1>;
            bindings = <&kp DOWN>
                , <&kp UP>
                , <&kp RIGHT>
                , <&kp LEFT>;
        };

        // Cursor Layer - Select Word (seq) - TailorKey
        cur_SELECT_WORD_v1_TKZ: cur_SELECT_WORD_v1_TKZ {
            label = "&CUR_SELECT_WORD_V1_TKZ";
            compatible = "zmk,behavior-macro";
            #binding-cells = <0>;
            tap-ms = <1>;
            wait-ms = <1>;
            bindings = <&kp LC(LEFT)>
                , <&kp LC(LS(RIGHT))>;
        };

        // mod_tab_switcher_chord -  TailorKey
        mod_tab_chord_v2_TKZ: mod_tab_chord_v2_TKZ {
            label = "&MOD_TAB_CHORD_V2_TKZ";
            compatible = "zmk,behavior-macro-two-param";
            #binding-cells = <2>;
            tap-ms = <0>;
            wait-ms = <0>;
            bindings = <&macro_press>
                , <&macro_param_2to1>
                , <&mo MACRO_PLACEHOLDER>
                , <&macro_press>
                , <&macro_param_1to1>
                , <&mod_tab_v2_TKZ MACRO_PLACEHOLDER>
                , <&macro_pause_for_release>
                , <&macro_release>
                , <&macro_param_1to1>
                , <&mod_tab_v2_TKZ MACRO_PLACEHOLDER>
                , <&macro_release>
                , <&macro_param_2to1>
                , <&mo MACRO_PLACEHOLDER>;
        };

        // mod_tab_switcher - TailorKey
        //
        //
        mod_tab_v2_TKZ: mod_tab_v2_TKZ {
            label = "&MOD_TAB_V2_TKZ";
            compatible = "zmk,behavior-macro-one-param";
            #binding-cells = <1>;
            tap-ms = <15>;
            wait-ms = <15>;
            bindings = <&macro_press>
                , <&macro_param_1to1>
                , <&kp MACRO_PLACEHOLDER>
                , <&macro_tap>
                , <&kp TAB>
                , <&macro_pause_for_release>
                , <&macro_release>
                , <&macro_param_1to1>
                , <&kp MACRO_PLACEHOLDER>;
        };

        // macro string1 sample - Magic Layer F1 - Text output sample macro 1 "¡Hola!" - TailorKey
        mstr1_v1_TKZ: mstr1_v1_TKZ {
            label = "&MSTR1_V1_TKZ";
            compatible = "zmk,behavior-macro";
            #binding-cells = <0>;
            bindings = <&macro_press>
                , <&kp RALT>
                , <&macro_tap>
                , <&kp KP_N0>
                , <&kp KP_N1>
                , <&kp KP_N6>
                , <&kp KP_N1>
                , <&macro_release>
                , <&kp RALT>
                , <&macro_press>
                , <&kp LSHFT>
                , <&macro_tap>
                , <&kp H>
                , <&macro_release>
                , <&kp LSHFT>
                , <&macro_tap>
                , <&kp O>
                , <&kp L>
                , <&kp A>
                , <&kp LS(N1)>
                , <&kp SPACE>
                , <&kp RET>;
        };

        // macro string2 sample - Magic Layer F2 - Text output sample macro 2 "grammar check: <paste>" - TailorKey
        mstr2_v1_TKZ: mstr2_v1_TKZ {
            label = "&MSTR2_V1_TKZ";
            compatible = "zmk,behavior-macro";
            #binding-cells = <0>;
            bindings = <&macro_tap>
                , <&kp G>
                , <&kp R>
                , <&kp A>
                , <&kp M>
                , <&kp M>
                , <&kp A>
                , <&kp R>
                , <&kp SPACE>
                , <&kp C>
                , <&kp H>
                , <&kp E>
                , <&kp C>
                , <&kp K>
                , <&kp LS(SEMI)>
                , <&kp LC(V)>
                , <&kp RET>;
        };

        openCloseQuote: openCloseQuote {
            label = "&OPENCLOSEQUOTE";
            compatible = "zmk,behavior-macro";
            #binding-cells = <0>;
            tap-ms = <5>;
            wait-ms = <5>;
            bindings = <&kp LS(SQT)>
                , <&kp LS(SQT)>
                , <&kp LEFT>;
        };

        fullScreenApp: fullScreenApp {
            label = "&FULLSCREENAPP";
            compatible = "zmk,behavior-macro";
            #binding-cells = <0>;
            tap-ms = <30>;
            wait-ms = <100>;
            bindings = <&kp LA(SPACE)>
                , <&macro_wait_time 100>
                , <&kp X>;
        };

        PasteThenCrtl: PasteThenCrtl {
            label = "&PASTETHENCRTL";
            compatible = "zmk,behavior-macro";
            #binding-cells = <0>;
            tap-ms = <45>;
            wait-ms = <100>;
            bindings = <&macro_tap>
                , <&kp LC(V)>
                , <&macro_wait_time 40>
                , <&kp LCTRL>;
        };

        crtlesv: crtlesv {
            label = "&CRTLESV";
            compatible = "zmk,behavior-macro";
            #binding-cells = <0>;
            tap-ms = <45>;
            wait-ms = <50>;
            bindings = <&kp LC(LA(V))>;
        };

        // Macro to drop the trace precedent arrow
        excel_trace: excel_trace {
            label = "&EXCEL_TRACE";
            compatible = "zmk,behavior-macro";
            #binding-cells = <0>;
            tap-ms = <30>;
            wait-ms = <100>;
            bindings = <&kp LALT>
                , <&kp M>
                , <&kp P>;
        };

        // Macro to wipe all arrows off the screen
        excel_clear_trace: excel_clear_trace {
            label = "&EXCEL_CLEAR_TRACE";
            compatible = "zmk,behavior-macro";
            #binding-cells = <0>;
            tap-ms = <30>;
            wait-ms = <100>;
            bindings = <&kp LALT>
                , <&kp M>
                , <&kp A>;
        };

        // Macro to instantly snap back to the formula cell
        excel_snapback_trace: excel_snapback_trace {
            label = "&EXCEL_SNAPBACK_TRACE";
            compatible = "zmk,behavior-macro";
            #binding-cells = <0>;
            tap-ms = <30>;
            wait-ms = <100>;
            bindings = <&kp F5>
                , <&kp RET>;
        };

        // Macro to drop the trace precedent arrow
        excel_zoom_menu: excel_zoom_menu {
            label = "&EXCEL_ZOOM_MENU";
            compatible = "zmk,behavior-macro";
            #binding-cells = <0>;
            tap-ms = <30>;
            wait-ms = <100>;
            bindings = <&kp LALT>
                , <&kp V>
                , <&kp Z>
                , <&kp TAB>;
        };

        snip_via_app: snip_via_app {
            label = "&SNIP_VIA_APP";
            compatible = "zmk,behavior-macro";
            #binding-cells = <0>;
            tap-ms = <15>;
            wait-ms = <15>;
            bindings = <&kp LC(LA(F13))>
                , <&macro_wait_time 50>
                , <&kp LA(N)>;
        };

        openCloseParenthesis: openCloseParenthesis {
            label = "&OPENCLOSEPARENTHESIS";
            compatible = "zmk,behavior-macro";
            #binding-cells = <0>;
            tap-ms = <5>;
            wait-ms = <5>;
            bindings = <&kp LS(N9)>
                , <&kp LS(N0)>
                , <&kp LEFT>;
        };

        openCloseBrackets: openCloseBrackets {
            label = "&OPENCLOSEBRACKETS";
            compatible = "zmk,behavior-macro";
            #binding-cells = <0>;
            tap-ms = <5>;
            wait-ms = <5>;
            bindings = <&kp LBKT>
                , <&kp RBKT>
                , <&kp LEFT>;
        };
    };
};

/* Automatically generated behavior definitions */
/ {
    behaviors {


        // AutoShift Helper - &AS main macro is chained to &AS_HT hold tap and &AS_Shifted macro. For faster typists, it is recommended to decrease the tapping-term-ms value. A suggested value is 135 ms.
        // More: https://github.com/nickcoutsos/keymap-editor/wiki/Autoshift-using-ZMK-behaviors
        AS_HT_v2_TKZ: AS_HT_v2_TKZ {
            compatible = "zmk,behavior-hold-tap";
            #binding-cells = <2>;
            tapping-term-ms = <190>;
            bindings = <&AS_Shifted_v1_TKZ>, <&kp>;
            flavor = "tap-preferred";
        };

        // Capsword helper - tap for caps_word - hold for key press
        CAPSWord_v1_TKZ: CAPSWord_v1_TKZ {
            compatible = "zmk,behavior-hold-tap";
            #binding-cells = <2>;
            tapping-term-ms = <200>;
            bindings = <&kp>, <&caps_word>;
        };

        // Homerow Mod for the left index finger - TailorKey.
        // For advanced tuning of HRM values, see: https://docs.google.com/spreadsheets/d/1ESgObQelyz4lnKlfwLYsmofLJulOMK5RdGBsopLe2o8
        HRM_left_index_v1_TKZ: HRM_left_index_v1_TKZ {
            compatible = "zmk,behavior-hold-tap";
            #binding-cells = <2>;
            tapping-term-ms = <225>;
            bindings = <&kp>, <&kp>;
            flavor = "tap-preferred";
            quick-tap-ms = <175>;
            require-prior-idle-ms = <140>;
            hold-trigger-key-positions = <POS_RH_T1 POS_RH_T2 POS_RH_T3 POS_RH_T6 POS_RH_T5 POS_RH_T4 POS_RH_C1R3 POS_RH_C2R3 POS_RH_C3R3 POS_RH_C4R3 POS_RH_C1R4 POS_RH_C2R4 POS_RH_C3R4 POS_RH_C4R4 POS_RH_C5R4 POS_RH_C1R5 POS_RH_C2R5 POS_RH_C3R5 POS_RH_C4R5 POS_RH_C5R5 POS_RH_C1R2 POS_RH_C2R2 POS_RH_C3R2 POS_RH_C4R2 POS_RH_C5R2 POS_RH_C5R3>;
        };

        // Homerow Mod for the left middle finger - TailorKey
        HRM_left_middy_v1_TKZ: HRM_left_middy_v1_TKZ {
            compatible = "zmk,behavior-hold-tap";
            #binding-cells = <2>;
            tapping-term-ms = <225>;
            bindings = <&kp>, <&kp>;
            flavor = "tap-preferred";
            quick-tap-ms = <175>;
            require-prior-idle-ms = <140>;
            hold-trigger-key-positions = <POS_RH_T1 POS_RH_T2 POS_RH_T3 POS_RH_T6 POS_RH_T5 POS_RH_T4 POS_RH_C1R2 POS_RH_C2R2 POS_RH_C3R2 POS_RH_C4R2 POS_RH_C1R3 POS_RH_C2R3 POS_RH_C3R3 POS_RH_C4R3 POS_RH_C1R4 POS_RH_C2R4 POS_RH_C3R4 POS_RH_C4R4 POS_RH_C5R4 POS_RH_C1R5 POS_RH_C2R5 POS_RH_C3R5 POS_RH_C4R5 POS_RH_C5R5 POS_RH_C5R2 POS_RH_C5R3>;
        };

        // Homerow Mod for the left pinky - TailorKey
        HRM_left_pinky_v1_TKZ: HRM_left_pinky_v1_TKZ {
            compatible = "zmk,behavior-hold-tap";
            #binding-cells = <2>;
            tapping-term-ms = <250>;
            bindings = <&kp>, <&kp>;
            flavor = "tap-preferred";
            quick-tap-ms = <175>;
            require-prior-idle-ms = <140>;
            hold-trigger-key-positions = <POS_RH_T1 POS_RH_T2 POS_RH_T3 POS_RH_T6 POS_RH_T5 POS_RH_T4 POS_RH_C2R3 POS_RH_C3R3 POS_RH_C4R3 POS_RH_C5R3 POS_RH_C3R4 POS_RH_C4R4 POS_RH_C5R4 POS_RH_C3R5 POS_RH_C4R5 POS_RH_C5R5 POS_RH_C1R3 POS_RH_C1R4 POS_RH_C2R4 POS_RH_C1R5 POS_RH_C2R5 POS_RH_C1R2 POS_RH_C2R2 POS_RH_C3R2 POS_RH_C4R2 POS_RH_C5R2>;
        };

        // Homerow Mod for the left ring finger 1 - TailorKey
        HRM_left_ring_v1_TKZ: HRM_left_ring_v1_TKZ {
            compatible = "zmk,behavior-hold-tap";
            #binding-cells = <2>;
            tapping-term-ms = <225>;
            bindings = <&kp>, <&kp>;
            flavor = "tap-preferred";
            quick-tap-ms = <175>;
            require-prior-idle-ms = <140>;
            hold-trigger-key-positions = <POS_RH_T1 POS_RH_T2 POS_RH_T3 POS_RH_T6 POS_RH_T5 POS_RH_T4 POS_RH_C1R2 POS_RH_C2R2 POS_RH_C3R2 POS_RH_C4R2 POS_RH_C1R3 POS_RH_C2R3 POS_RH_C3R3 POS_RH_C4R3 POS_RH_C1R4 POS_RH_C2R4 POS_RH_C3R4 POS_RH_C4R4 POS_RH_C1R5 POS_RH_C2R5 POS_RH_C3R5 POS_RH_C4R5 POS_RH_C5R2 POS_RH_C5R3 POS_RH_C5R4 POS_RH_C5R5>;
        };

        // Homerow Mod for the right index finger - TailorKey
        HRM_right_index_v1_TKZ: HRM_right_index_v1_TKZ {
            compatible = "zmk,behavior-hold-tap";
            #binding-cells = <2>;
            tapping-term-ms = <225>;
            bindings = <&kp>, <&kp>;
            flavor = "tap-preferred";
            quick-tap-ms = <175>;
            require-prior-idle-ms = <140>;
            hold-trigger-key-positions = <POS_LH_T1 POS_LH_T2 POS_LH_T3 POS_LH_T6 POS_LH_T5 POS_LH_T4 POS_LH_C5R3 POS_LH_C4R3 POS_LH_C3R3 POS_LH_C2R3 POS_LH_C1R3 POS_LH_C5R4 POS_LH_C4R4 POS_LH_C3R4 POS_LH_C2R4 POS_LH_C1R4 POS_LH_C5R5 POS_LH_C4R5 POS_LH_C3R5 POS_LH_C2R5 POS_LH_C1R5 POS_LH_C5R2 POS_LH_C4R2 POS_LH_C3R2 POS_LH_C2R2 POS_LH_C1R2>;
        };

        // Homerow Mod for the right middle finger - TailorKey
        HRM_right_middy_v1_TKZ: HRM_right_middy_v1_TKZ {
            compatible = "zmk,behavior-hold-tap";
            #binding-cells = <2>;
            tapping-term-ms = <225>;
            bindings = <&kp>, <&kp>;
            flavor = "tap-preferred";
            quick-tap-ms = <175>;
            require-prior-idle-ms = <140>;
            hold-trigger-key-positions = <POS_LH_T1 POS_LH_T2 POS_LH_T3 POS_LH_T6 POS_LH_T5 POS_LH_T4 POS_LH_C5R3 POS_LH_C4R3 POS_LH_C3R3 POS_LH_C2R3 POS_LH_C1R3 POS_LH_C5R4 POS_LH_C4R4 POS_LH_C3R4 POS_LH_C2R4 POS_LH_C1R4 POS_LH_C5R5 POS_LH_C4R5 POS_LH_C3R5 POS_LH_C2R5 POS_LH_C1R5 POS_LH_C5R2 POS_LH_C4R2 POS_LH_C3R2 POS_LH_C2R2 POS_LH_C1R2>;
        };

        // Homerow Mod for the right pinky - TailorKey
        HRM_right_pinky_v1_TKZ: HRM_right_pinky_v1_TKZ {
            compatible = "zmk,behavior-hold-tap";
            #binding-cells = <2>;
            tapping-term-ms = <250>;
            bindings = <&kp>, <&kp>;
            flavor = "tap-preferred";
            quick-tap-ms = <175>;
            require-prior-idle-ms = <140>;
            hold-trigger-key-positions = <POS_LH_C5R3 POS_LH_C4R3 POS_LH_C3R3 POS_LH_C1R3 POS_LH_C2R3 POS_LH_C5R5 POS_LH_C4R4 POS_LH_C3R4 POS_LH_C2R4 POS_LH_C1R4 POS_LH_C1R5 POS_LH_C2R5 POS_LH_C3R5 POS_LH_C5R4 POS_LH_C4R5 POS_LH_C5R2 POS_LH_C4R2 POS_LH_C3R2 POS_LH_C2R2 POS_LH_C1R2>;
        };

        // Homerow Mod for the right ring 1 - TailorKey
        //
        HRM_right_ring_v1_TKZ: HRM_right_ring_v1_TKZ {
            compatible = "zmk,behavior-hold-tap";
            #binding-cells = <2>;
            tapping-term-ms = <225>;
            bindings = <&kp>, <&kp>;
            flavor = "tap-preferred";
            quick-tap-ms = <175>;
            require-prior-idle-ms = <140>;
            hold-trigger-key-positions = <POS_LH_T1 POS_LH_T2 POS_LH_T3 POS_LH_T6 POS_LH_T5 POS_LH_T4 POS_LH_C5R3 POS_LH_C4R3 POS_LH_C3R3 POS_LH_C2R3 POS_LH_C1R3 POS_LH_C5R4 POS_LH_C4R4 POS_LH_C3R4 POS_LH_C2R4 POS_LH_C1R4 POS_LH_C5R5 POS_LH_C4R5 POS_LH_C3R5 POS_LH_C2R5 POS_LH_C1R5 POS_LH_C5R2 POS_LH_C4R2 POS_LH_C3R2 POS_LH_C2R2 POS_LH_C1R2>;
        };

        // space_layer_access - TailorKey
        space_v3_TKZ: space_v3_TKZ {
            compatible = "zmk,behavior-hold-tap";
            #binding-cells = <2>;
            tapping-term-ms = <200>;
            bindings = <&mo>, <&kp>;
            flavor = "balanced";
            quick-tap-ms = <175>;
            require-prior-idle-ms = <150>;
        };

        // thumb_layer_access - TailorKey
        thumb_v2_TKZ: thumb_v2_TKZ {
            compatible = "zmk,behavior-hold-tap";
            #binding-cells = <2>;
            tapping-term-ms = <250>;
            bindings = <&mo>, <&kp>;
            flavor = "tap-preferred";
            quick-tap-ms = <175>;
            require-prior-idle-ms = <150>;
        };

        // thumb_layer_access - TailorKey
        Magic_v2_TKZ: Magic_v2_TKZ {
            compatible = "zmk,behavior-hold-tap";
            #binding-cells = <2>;
            tapping-term-ms = <250>;
            bindings = <&mo>, <&kp>;
            flavor = "tap-preferred";
            quick-tap-ms = <175>;
        };

        // thumb_layer_access - TailorKey
        thumb_kp_kp: thumb_kp_kp {
            compatible = "zmk,behavior-hold-tap";
            #binding-cells = <2>;
            tapping-term-ms = <200>;
            bindings = <&kp>, <&kp>;
            flavor = "tap-preferred";
        };

        // thumb_layer_access - TailorKey
        thumb_ctrlpaste_esv: thumb_ctrlpaste_esv {
            compatible = "zmk,behavior-hold-tap";
            #binding-cells = <2>;
            tapping-term-ms = <200>;
            bindings = <&kp>, <&kp>;
            flavor = "tap-preferred";
        };

        // thumb_layer_access - TailorKey
        thumb_paste_pastethenctrl: thumb_paste_pastethenctrl {
            compatible = "zmk,behavior-hold-tap";
            #binding-cells = <2>;
            tapping-term-ms = <200>;
            bindings = <&PasteThenCrtl>, <&kp>;
            flavor = "tap-preferred";
        };

        excel_trace_holdtoclear: excel_trace_holdtoclear {
            compatible = "zmk,behavior-hold-tap";
            #binding-cells = <2>;
            tapping-term-ms = <280>;
            bindings = <&excel_clear_trace>, <&excel_trace>;
            flavor = "tap-preferred";
            quick-tap-ms = <175>;
        };

        // thumb_layer_access - TailorKey
        thumb_Right_v2_TKZ: thumb_Right_v2_TKZ {
            compatible = "zmk,behavior-hold-tap";
            #binding-cells = <2>;
            tapping-term-ms = <250>;
            bindings = <&mo>, <&kp>;
            flavor = "tap-preferred";
            quick-tap-ms = <175>;
            require-prior-idle-ms = <0>;
        };

        // thumb_layer_access - TailorKey
        Magic_TapPreferred: Magic_TapPreferred {
            compatible = "zmk,behavior-hold-tap";
            #binding-cells = <2>;
            tapping-term-ms = <250>;
            bindings = <&mo>, <&kp>;
            flavor = "tap-preferred";
            quick-tap-ms = <175>;
            require-prior-idle-ms = <100>;
        };

        trace_jump_snap: trace_jump_snap {
            compatible = "zmk,behavior-hold-tap";
            #binding-cells = <2>;
            tapping-term-ms = <250>;
            bindings = <&excel_snapback_trace>, <&kp>;
            flavor = "tap-preferred";
            quick-tap-ms = <175>;
        };
    };
};

/* Automatically generated combos definitions */
/ {
    combos {
        compatible = "zmk,combos";

        combo_tildaOnlyCombo {
            timeout-ms = <40>;
            key-positions = <POS_RH_C1R2 POS_RH_C2R2>;
            bindings = <&kp LS(GRAVE)>;
            layers = <LAYER_Main_w_hrm>;
            require-prior-idle-ms = <100>;
        };

        // ctrlAltDel
        combo_ctrlAltDel {
            timeout-ms = <50>;
            key-positions = <POS_LH_C3R1 POS_LH_C2R1>;
            bindings = <&kp LC(LA(DEL))>;
            require-prior-idle-ms = <100>;
        };

        combo_ZoomMenu {
            key-positions = <POS_RH_C2R2 POS_RH_C3R2>;
            bindings = <&excel_zoom_menu>;
            layers = <LAYER_Cursor_right_hand LAYER_Cursor>;
        };
    };
};

/* Automatically generated keymap */
/ {
    keymap {
        compatible = "zmk,keymap";


        layer_Main_w_hrm {
            bindings = <
                                 &none                          &none                         &none                           &none                                &none                                                                                                                                                                                         &none                            &none                          &none            &none  &kp LS(GRAVE)
                            &kp LS(N4)                     &kp LS(N2)            &openCloseBrackets           &openCloseParenthesis                         &kp LS(SEMI)  &kp EQUAL                                                                                                                                        &kp LS(N8)                     &under_minus                      &kp LS(SQT)                &openCloseQuote       &kp LS(N3)     &kp LS(N5)
                                 &none                          &kp Q                         &kp W                           &kp E                                &kp R      &kp T                                                                                                                                             &kp Y                            &kp U                            &kp I                          &kp O            &kp P    &kp LS(RET)
                              &kp LALT  &HRM_left_pinky_v1_TKZ LGUI A  &HRM_left_ring_v1_TKZ LALT S  &HRM_left_middy_v1_TKZ LCTRL D       &HRM_left_index_v1_TKZ LSHFT F      &kp G                                                                                                                                             &kp H  &HRM_right_index_v1_TKZ RSHFT J  &HRM_right_middy_v1_TKZ RCTRL K  &HRM_right_ring_v1_TKZ LALT L  &slash_amps_hrm       &kp RALT
                                 &none                          &kp Z                         &kp X                           &kp C                                &kp V      &kp B                       &kp LS(TAB)      &kp LC(BSPC)         &kp DEL  &kp ESC      &kp LA(RET)                                 &kp TAB       &kp N                            &kp M                      &comma_ques                 &period_exclam         &kp SEMI      &kp PG_UP
 &Magic_TapPreferred LAYER_Magic K_APP                 &mo LAYER_LB04                &mo LAYER_LB03                &mo LAYER_LB02_l  &mo LAYER_LB01_copy_paste_and_excel             &thumb_v2_TKZ LAYER_Numbers BSPC  &mo LAYER_Cursor  &mo LAYER_Fkey  &kp RET  &mo LAYER_Mouse  &thumb_Right_v2_TKZ LAYER_Symbol SPACE                                    &kp MINUS                          &kp SQT                    &qmark_excl         &kp BSLH      &kp PG_DN
            >;
        };

        layer_Numbers {
            bindings = <
  &none      &none    &none  &n7_lbkt      &none                                                                                                        &none         &none     &none     &none   &none
  &none      &none    &none     &none      &none          &none                                                                        &none            &none         &none     &none     &none   &none
  &none     &kp N9   &kp N9    &kp N9     &kp N9  &kp LS(EQUAL)                                                                      &kp DOT  &kp KP_MULTIPLY  &kp KP_SLASH     &none     &none   &none
  &none  &n4_prcnt  &n3_dlr  &n2_lpar   &n1_rpar      &kp EQUAL                                                                    &kp EQUAL        &kp RSHFT     &kp RCTRL  &kp RALT  &kp RGUI   &none
  &none   &n8_amps   &kp N7  &n6_hash  &n5_quote   &minus_slash   &none   &none  &kp N9  &kp KP_SLASH  &kp KP_MULTIPLY    &kp DOT    &kp DOT    &kp LS(EQUAL)     &kp MINUS     &none     &none   &none
  &none     &n0_eq   &n0_eq    &n0_eq     &n0_eq                  &none   &none  &kp N9     &kp MINUS    &kp LS(EQUAL)  &kp EQUAL                       &none         &none     &none     &none   &none
            >;
        };

        layer_Symbol {
            bindings = <
  &none       &none         &none         &none         &none                                                                                        &none          &none        &none        &none   &none
  &none       &none         &none         &none         &none  &kp LC(GRAVE)                                                          &none          &none          &none        &none        &none   &none
  &none  &kp LS(N3)    &kp LS(N4)      &kp LBKT      &kp RBKT     &kp LS(N6)                                                       &kp FSLH     &kp LS(N8)     &kp LS(N5)       &kp F9      &kp ESC   &none
  &none  &kp LS(N7)   &kp LS(SQT)    &kp LS(N9)    &kp LS(N0)      &kp COMMA                                                      &kp EQUAL  &kp LS(EQUAL)      &kp MINUS       &kp F4       &kp F2   &none
  &none  &kp LS(N2)  &kp LS(SEMI)  &kp LS(LBKT)  &kp LS(RBKT)        &kp SQT   &none   &none   &none   &none   &none   &none  &kp LS(COMMA)    &kp LS(DOT)  &kp LS(MINUS)  &kp LA(RET)  &kp LA(RET)   &none
  &none       &none         &none         &none         &none                  &none   &none   &none   &none   &none   &none                         &none          &none        &none        &none   &none
            >;
        };

        layer_Mouse {
            bindings = <
             &none      &none             &none              &none             &none                                                                                                                                                                    &none           &none            &none                &none              &none
             &none   &kp LALT  &excel_zoom_menu   &kp LC(KP_MINUS)   &kp LC(KP_PLUS)   &excel_zoom_menu                                                                                                                                 &none           &none           &none            &none                &none              &none
             &none      &none             &none              &none             &none              &none                                                                                                                                 &none           &none    &mmv MOVE_UP            &none                &none              &none
             &none  &mkp RCLK         &kp LSHFT          &kp LCTRL         &mkp LCLK   &msc MOVE_Y(500)                                                                                                                                 &none  &mmv MOVE_LEFT  &mmv MOVE_DOWN  &mmv MOVE_RIGHT                &none              &none
  &msc MOVE_Y(100)      &none             &none  &msc MOVE_X(-500)  &msc MOVE_X(500)  &msc MOVE_Y(-500)      &mo LAYER_Mouse        &kp LC(LS(C))        &kp LS(LG(S))            &kp LSHFT  &mo LAYER_MouseFast            &kp LCTRL   &none           &none           &none            &none  &mo LAYER_MouseFast  &msc MOVE_Y(1000)
 &msc MOVE_Y(-100)      &none             &none              &none             &none                     &mo LAYER_MouseSlow  &mo LAYER_MouseFast  &mo LAYER_MouseWarp  &mo LAYER_MouseWarp  &mo LAYER_MouseFast  &mo LAYER_MouseSlow                   &none           &none            &none                &none  &msc MOVE_Y(-500)
            >;
        };

        layer_Fkey {
            bindings = <
  &none    &none    &none    &none    &none                                                                      &none      &none     &none     &none      &none
  &none    &none    &none    &none    &none   &none                                                   &none      &none      &none     &none     &none      &none
  &none    &none    &none    &none  &kp F13   &none                                                   &none      &none      &none     &none     &none      &none
  &none   &kp F4   &kp F3   &kp F2   &kp F1   &none                                                   &none  &kp RSHFT  &kp RCTRL  &kp RALT  &kp RGUI      &none
  &none   &kp F8   &kp F7   &kp F6   &kp F5   &none   &none   &none   &none   &none   &none   &none   &none      &none      &none     &none     &none  &kp PG_UP
  &none  &kp F12  &kp F11  &kp F10   &kp F9           &none   &none   &none   &none   &none   &none              &none      &none     &none     &none  &kp PG_DN
            >;
        };

        layer_PgUpDwn {
            bindings = <
    &kp ESC         &none        &none         &none          &none                                                                                                    &none            &none          &none     &none      &none
 &kp LA(N5)         &none   &kp LA(N3)    &kp LA(N2)     &kp LA(N1)    &kp ESC                                                                            &none        &none            &none          &none     &none      &none
      &none         &none  &kp LS(TAB)     &kp PG_UP        &kp TAB    &kp ESC                                                                     &kp LC(LBKT)  &kp LC(F13)      &kp LC(F14)    &kp LC(F15)   &kp TAB      &none
      &none         &none     &kp LEFT     &kp PG_DN      &kp RIGHT    &kp RET                                                                     &kp LC(RBKT)    &kp RSHFT        &kp RCTRL       &kp LALT  &kp LGUI   &kp HOME
  &kp PG_UP         &none  &kp LS(TAB)   &kp LS(TAB)        &kp TAB  &kp SPACE    &kp PG_UP  &kp PG_DN  &kp DEL   &none             &none   &none     &kp LC(G)       &trans  &kp LS(LC(TAB))    &kp LC(TAB)   &kp END  &kp PG_UP
  &kp PG_DN  &kp LA(LEFT)   &kp LA(UP)  &kp LA(DOWN)  &kp LA(RIGHT)             &kp LS(TAB)    &kp TAB  &kp RET   &none  &mo LAYER_Cursor   &none                      &none    &kp LC(PG_UP)  &kp LC(PG_DN)     &none  &kp PG_DN
            >;
        };

        layer_Cursor_right_hand {
            bindings = <
           &kp ESC         &none        &none         &none          &none                                                                                                  &none            &none          &none        &none     &none
        &kp LA(N5)         &none   &kp LA(N3)    &kp LA(N2)     &kp LA(N1)   &none                                                                        &none  &kp LC(KP_MINUS)  &kp LC(KP_PLUS)          &none        &none     &none
             &none         &none  &kp LS(TAB)        &kp UP        &kp TAB   &none                                                                 &kp LC(LBKT)             &none            &none          &none      &kp TAB     &none
             &none         &none     &kp LEFT      &kp DOWN      &kp RIGHT   &none                                                                 &kp LC(RBKT)         &kp RSHFT        &kp RCTRL       &kp LALT     &kp LGUI     &none
  &msc MOVE_Y(200)         &none        &none         &none          &none   &none   &none             &none   &none     &none   &none      &none         &none       &kp LC(F13)      &kp LC(F14)    &kp LC(F15)        &none  &kp HOME
 &msc MOVE_Y(-200)  &kp LA(LEFT)   &kp LA(UP)  &kp LA(DOWN)  &kp LA(RIGHT)           &none  &mo LAYER_Cursor   &none  &kp LEFT   &none  &kp RIGHT                 &kp LC(LS(TAB))    &kp LC(PG_UP)  &kp LC(PG_DN)  &kp LC(TAB)   &kp END
            >;
        };

        layer_Cursor {
            bindings = <
      &kp LC(HOME)   &kp LC(END)        &none         &none          &none                                                                                                                                                                      &none  &kp LC(GRAVE)        &none  &kp LC(HOME)  &kp LC(END)
             &none         &none        &none         &none          &none    &none                                                                                                          &trace_jump_snap 0 LC(LBKT)                        &none          &none        &none         &none        &none
             &none         &none  &kp LS(TAB)        &kp UP        &kp TAB    &none                                                                                                         &excel_trace_holdtoclear 0 0  &trace_jump_snap 0 LC(LBKT)          &none        &none       &kp TAB        &none
             &none      &kp HOME     &kp LEFT      &kp DOWN      &kp RIGHT  &kp END                                                                                                                            &kp LC(G)                    &kp RSHFT      &kp RCTRL     &kp LALT      &kp LGUI        &none
  &msc MOVE_Y(200)         &none        &none         &none          &none    &none   &none   &none   &none                   &none                        &none  &mo LAYER_Cursor_onenote                         &none                  &kp LC(F13)    &kp LC(F14)  &kp LC(F15)         &none     &kp HOME
 &msc MOVE_Y(-200)  &kp LA(LEFT)   &kp LA(UP)  &kp LA(DOWN)  &kp LA(RIGHT)            &none   &none   &none  &mo LAYER_Cursor_excel  &mo LAYER_Cursor_right_hand  &mo LAYER_Cursor_outlook                                              &kp LC(PG_UP)  &kp LC(PG_DN)        &none         &none      &kp END
            >;
        };

        layer_Cursor_outlook {
            bindings = <
 &trans  &trans  &trans  &trans  &trans                                                                                           &trans      &trans      &trans  &trans  &trans
 &trans  &trans  &trans  &trans  &trans  &trans                                                                       &trans      &trans      &trans      &trans  &trans  &trans
 &trans  &trans  &trans  &trans  &trans  &trans                                                                    &kp LC(Y)      &trans      &trans      &trans  &trans  &trans
 &trans  &trans  &trans  &trans  &trans  &trans                                                                    &kp LC(E)      &trans      &trans      &trans  &trans  &trans
 &trans  &trans  &trans  &trans  &trans  &trans  &trans                    &trans  &trans  &trans  &trans  &trans     &trans  &kp LA(N1)  &kp LA(N2)  &kp LA(N3)  &trans  &trans
 &trans  &trans  &trans  &trans  &trans          &trans  &mo LAYER_Cursor_outlook  &trans  &trans  &trans  &trans                 &trans      &trans      &trans  &trans  &trans
            >;
        };

        layer_Cursor_onenote {
            bindings = <
 &trans  &trans  &trans  &trans  &trans                                                                                           &trans      &trans      &trans  &trans  &trans
 &trans  &trans  &trans  &trans  &trans  &trans                                                                       &trans      &trans      &trans      &trans  &trans  &trans
 &trans  &trans  &trans  &trans  &trans  &trans                                                                    &kp LC(Y)      &trans      &trans      &trans  &trans  &trans
 &trans  &trans  &trans  &trans  &trans  &trans                                                                    &kp LC(E)      &trans      &trans      &trans  &trans  &trans
 &trans  &trans  &trans  &trans  &trans  &trans  &trans                    &trans  &trans  &trans  &trans  &trans     &trans  &kp LC(N1)  &kp LA(N2)  &kp LA(N3)  &trans  &trans
 &trans  &trans  &trans  &trans  &trans          &trans  &mo LAYER_Cursor_onenote  &trans  &trans  &trans  &trans                 &trans      &trans      &trans  &trans  &trans
            >;
        };

        layer_Cursor_excel {
            bindings = <
 &trans  &trans  &trans  &trans  &trans                                                                                                               &trans      &trans      &trans  &trans  &trans
 &trans  &trans  &trans  &trans  &trans                        &trans                                                                     &trans      &trans      &trans      &trans  &trans  &trans
 &trans  &trans  &trans  &trans  &trans  &excel_trace_holdtoclear 0 0                                                                  &kp LC(Y)      &trans      &trans      &trans  &trans  &trans
 &trans  &trans  &trans  &trans  &trans                        &trans                                                                  &kp LC(E)      &trans      &trans      &trans  &trans  &trans
 &trans  &trans  &trans  &trans  &trans                        &trans  &trans                  &trans  &trans  &trans  &trans  &trans     &trans  &kp LC(N1)  &kp LA(N2)  &kp LA(N3)  &trans  &trans
 &trans  &trans  &trans  &trans  &trans                                &trans  &mo LAYER_Cursor_excel  &trans  &trans  &trans  &trans                 &trans      &trans      &trans  &trans  &trans
            >;
        };

        layer_MouseFast {
            bindings = <
 &trans     &trans     &trans     &trans     &trans                                                                             &trans          &trans           &trans           &trans            &trans
 &trans     &trans     &trans     &trans     &trans  &trans                                                     &trans          &trans          &trans           &trans           &trans            &trans
 &trans     &trans     &trans     &trans     &trans  &trans                                                  &mkp LCLK  &msc SCRL_DOWN    &mmv MOVE_UP   &mmv MOVE_LEFT  &mmv MOVE_RIGHT         &mkp RCLK
 &trans  &kp LSHFT  &kp LCTRL  &mkp RCLK  &mkp LCLK  &trans                                                  &mkp LCLK  &mmv MOVE_LEFT  &mmv MOVE_DOWN  &mmv MOVE_RIGHT        &mkp RCLK      &msc SCRL_UP
 &trans     &trans   &kp LALT     &trans     &trans  &trans  &trans  &trans  &trans  &trans  &trans  &trans  &mkp LCLK  &msc SCRL_LEFT  &mmv MOVE_DOWN     &mmv MOVE_UP  &msc SCRL_RIGHT   &msc MOVE_Y(20)
 &trans     &trans     &trans     &trans     &trans          &trans  &trans  &trans  &trans  &trans  &trans              &kp LA(PG_UP)       &kp PG_DN        &kp PG_UP    &kp LA(PG_DN)  &msc MOVE_Y(-20)
            >;
        };

        layer_MouseSlow {
            bindings = <
 &trans     &trans     &trans     &trans     &trans                                                                             &trans          &trans        &trans           &trans            &trans
 &trans     &trans     &trans     &trans     &trans  &trans                                                     &trans          &trans          &trans        &trans           &trans            &trans
 &trans     &trans     &trans     &trans     &trans  &trans                                                  &mkp LCLK  &mmv MOVE_LEFT    &mmv MOVE_UP  &mmv MOVE_UP  &mmv MOVE_RIGHT         &mkp RCLK
 &trans  &kp LSHFT  &kp LCTRL  &mkp RCLK  &mkp LCLK  &trans                                                  &mkp LCLK  &mmv MOVE_LEFT  &mmv MOVE_DOWN  &mmv MOVE_UP  &mmv MOVE_RIGHT            &trans
 &trans     &trans   &kp LALT     &trans     &trans  &trans  &trans  &trans  &trans  &trans  &trans  &trans  &mkp LCLK  &msc SCRL_LEFT  &msc SCRL_DOWN  &msc SCRL_UP  &msc SCRL_RIGHT      &msc SCRL_UP
 &trans     &trans     &trans     &trans     &trans          &trans  &trans  &trans  &trans  &trans  &trans              &kp LA(PG_UP)       &kp PG_DN     &kp PG_UP    &kp LA(PG_DN)  &msc MOVE_Y(-10)
            >;
        };

        layer_MouseWarp {
            bindings = <
 &trans  &trans  &trans  &trans  &trans                                                                             &trans             &trans        &trans           &trans     &trans
 &trans  &trans  &trans  &trans  &trans  &trans                                                     &trans          &trans             &trans        &trans           &trans     &trans
 &trans  &trans  &trans  &trans  &trans  &trans                                                  &mkp LCLK  &mmv MOVE_LEFT  &mmv MOVE_Y(-600)  &mmv MOVE_UP  &mmv MOVE_RIGHT  &mkp RCLK
 &trans  &trans  &trans  &trans  &trans  &trans                                                     &trans  &mmv MOVE_LEFT     &mmv MOVE_DOWN  &mmv MOVE_UP  &mmv MOVE_RIGHT     &trans
 &trans  &trans  &trans  &trans  &trans  &trans  &trans  &trans  &trans  &trans  &trans  &trans  &mkp LCLK  &msc SCRL_LEFT     &msc SCRL_DOWN  &msc SCRL_UP  &msc SCRL_RIGHT  &kp PG_UP
 &trans  &trans  &trans  &trans  &trans          &trans  &trans  &trans  &trans  &trans  &trans              &kp LA(PG_UP)          &kp PG_DN     &kp PG_UP    &kp LA(PG_DN)  &kp PG_DN
            >;
        };

        layer_Cursor_shift {
            bindings = <
                 &kp ESC           &kp ESC           &none             &none              &none                                                                                                                                       &none          &none      &none      &none      &none
                   &none             &none           &none             &none              &none            &none                                                                                                         &none        &none          &none      &none      &none      &none
 &cur_SELECT_NONE_v1_TKZ             &none           &none             &none      &kp LS(SPACE)    &kp LC(SPACE)                                                                                                     &kp LC(X)  &kp LS(TAB)         &kp UP  &kp LC(Y)    &kp TAB      &none
 &cur_SELECT_NONE_v1_TKZ  &kp LC(LS(LEFT))  &kp LC(LS(UP))  &kp LC(LS(DOWN))  &kp LC(LS(RIGHT))  &kp LC(LS(END))                                                                                                     &kp LC(C)    &kp RSHFT      &kp RCTRL   &kp LALT   &kp LGUI  &sk RSHFT
 &cur_SELECT_NONE_v1_TKZ      &kp LS(LEFT)      &kp LS(UP)      &kp LS(DOWN)      &kp LS(RIGHT)    &kp LS(SPACE)   &none   &none   &none  &cur_SELECT_NONE_v1_TKZ                    &none                    &none  &kp LC(V)    &kp PG_UP      &kp PG_DN  &kp PG_DN    &kp END  &kp LC(L)
                 &kp ESC      &kp LA(LEFT)      &kp LA(UP)      &kp LA(DOWN)      &kp LA(RIGHT)                    &none   &none   &none                &kp LC(A)  &cur_SELECT_LINE_v1_TKZ  &cur_SELECT_WORD_v1_TKZ               &kp LC(F)  &kp LC(LS(G))  &kp LC(G)  &kp LC(H)  &kp LC(K)
            >;
        };

        layer_LB01_copy_paste_and_excel {
            bindings = <
  &none      &none      &none   &none   &none                                                                                                                                       &none   &none   &none   &none   &none
  &none      &none      &none   &none   &none   &none                                                                                                                       &none   &none   &none   &none   &none   &none
  &none      &none      &none   &none   &none   &none                                                                                                                       &none   &none   &none   &none   &none   &none
  &none      &none      &none   &none   &none   &none                                                                                                                       &none   &none   &none   &none   &none   &none
  &none      &none      &none   &none   &none   &none  &kp LA(LC(F13))      &none  &kp LS(LG(T))  &kp LG(LS(T))  &PasteThenCrtl                             &kp LA(LC(V))   &none   &none   &none   &none   &none   &none
  &none  &kp LC(Z)  &kp LC(Y)   &none   &none                &kp LC(C)  &kp LC(X)  &kp LS(LG(S))      &kp LG(V)       &kp LC(V)  &thumb_ctrlpaste_esv LC(LA(V)) LC(LS(V))           &none   &none   &none   &none   &none
            >;
        };

        layer_LB02_l {
            bindings = <
  &none   &none   &none   &none                 &none                                                                                                                        &none   &none   &none   &none   &none
  &none   &none   &none   &none                 &none   &none                                                                                                        &none   &none   &none   &none   &none   &none
  &none   &none   &none   &none                 &none   &none                                                                                                        &none   &none   &none   &none   &none   &none
  &none   &none   &none   &none                 &none   &none                                                                                                        &none   &none   &none   &none   &none   &none
  &none   &none   &none   &none                 &none   &none  &kp LG(LC(LEFT))  &kp LC(LG(RIGHT))      &none   &kp LG(LC(D))             &none        &kp LG(TAB)   &none   &none   &none   &none   &none   &none
  &none   &none   &none   &none  &mod_tab_v2_TKZ LALT                  &kp LEFT          &kp RIGHT  &kp LC(W)  &kp LC(LG(F4))  &kp LG(LC(LEFT))  &kp LC(LG(RIGHT))           &none   &none   &none   &none   &none
            >;
        };

        layer_LB03 {
            bindings = <
  &none   &none   &none                                       &none              &none                                                                                                      &none   &none   &none   &none   &none
  &none   &none   &none                                       &none              &none   &none                                                                                      &none   &none   &none   &none   &none   &none
  &none   &none   &none                                       &none              &none   &none                                                                                      &none   &none   &none   &none   &none   &none
  &none   &none   &none                                       &none              &none   &none                                                                                      &none   &none   &none   &none   &none   &none
  &none   &none   &none                              &fullScreenApp     &fullScreenApp   &none  &kp LS(LG(LEFT))  &kp LG(LS(RIGHT))             &kp LC(W)   &none   &none   &none   &none   &none   &none   &none   &none   &none
  &none   &none   &none  &thumb_v2_TKZ LAYER_LB03_LB02 LG(LS(LEFT))  &kp LG(LS(RIGHT))          &kp LG(LC(LEFT))  &kp LG(LC(RIGHT))  &mod_tab_v2_TKZ LGUI   &none   &none   &none           &none   &none   &none   &none   &none
            >;
        };

        layer_Lower {
            bindings = <
         &kp C_BRI_DN  &kp C_BRI_UP      &kp C_PREV      &kp C_NEXT         &kp C_PP                                                                                       &kp C_MUTE  &kp C_VOL_DN  &kp C_VOL_UP            &none  &kp PAUSE_BREAK
               &trans         &none           &none           &none            &none   &kp HOME                                                                &kp LS(N9)  &kp KP_NUM     &kp EQUAL  &kp KP_SLASH  &kp KP_MULTIPLY  &kp PRINTSCREEN
               &trans         &none           &none    &kp UP_ARROW            &none    &kp END                                                                &kp LS(N0)   &kp KP_N7     &kp KP_N8     &kp KP_N9     &kp KP_MINUS   &kp SCROLLLOCK
               &trans         &none  &kp LEFT_ARROW  &kp DOWN_ARROW  &kp RIGHT_ARROW  &kp PG_UP                                                                &kp LS(N5)   &kp KP_N4     &kp KP_N5     &kp KP_N6      &kp KP_PLUS            &none
               &trans     &kp K_APP           &none         &kp F11          &kp F12  &kp PG_DN  &trans  &trans  &to LAYER_Main_w_hrm  &trans  &trans  &trans   &kp COMMA   &kp KP_N1     &kp KP_N2     &kp KP_N3     &kp KP_ENTER           &trans
 &magic LAYER_Magic 0      &kp CAPS         &kp INS         &kp F11          &kp F12             &trans  &trans                &trans  &trans  &trans  &trans               &kp KP_N0     &kp KP_N0    &kp KP_DOT     &kp KP_ENTER           &trans
            >;
        };

        layer_Magic {
            bindings = <
        &mstr1_v1_TKZ    &mstr2_v1_TKZ            &none            &none            &none                                                                                       &none   &none   &none  &bt BT_CLR  &bt BT_CLR_ALL
 &to LAYER_Main_w_hrm            &none            &none            &none            &none  &to LAYER_Main_w_hrm                                                         &none   &none   &none   &none       &none           &none
                &none  &rgb_ug RGB_SPI  &rgb_ug RGB_SAI  &rgb_ug RGB_HUI  &rgb_ug RGB_BRI       &rgb_ug RGB_TOG                                                         &none   &none   &none   &none       &none           &none
          &bootloader  &rgb_ug RGB_SPD  &rgb_ug RGB_SAD  &rgb_ug RGB_HUD  &rgb_ug RGB_BRD       &rgb_ug RGB_EFF                                                         &none   &none   &none   &none       &none     &bootloader
           &sys_reset            &none            &none            &none            &none                 &none   &bt_2   &bt_3         &none   &none   &none   &none   &none   &none   &none   &none       &none      &sys_reset
                &none            &none            &none            &none            &none                         &bt_0   &bt_1  &out OUT_USB   &none   &none   &none           &none   &none   &none       &none           &none
            >;
        };

        layer_Left_middle_hrm {
            bindings = <
               &kp F5                         &kp F4                        &kp F3                          &kp F2                       &kp MINUS                                                                                                                                                                                                  &kp F6                           &kp F7                         &kp F8                             &kp F9    &kp F10
               &kp N5                         &kp N4                        &kp N3                          &kp N2                          &kp N1  &kp N0                                                                                                                                                      &kp EQUAL                           &kp N6                           &kp N7                         &kp N8                             &kp N9    &kp F11
            &kp GRAVE                          &kp Q                         &kp W                           &kp E                           &kp R   &kp T                                                                                                                                                          &kp Y                            &kp U                            &kp I                          &kp O                              &kp P   &kp BSLH
                &none  &HRM_left_pinky_v1_TKZ LGUI A  &HRM_left_ring_v1_TKZ LALT S  &HRM_left_middy_v1_TKZ LCTRL D  &HRM_left_index_v1_TKZ LSHFT F   &kp G                                                                                                                                                          &kp H  &HRM_right_index_v1_TKZ RSHFT J  &HRM_right_middy_v1_TKZ RCTRL K  &HRM_right_ring_v1_TKZ LALT L  &HRM_right_pinky_v1_TKZ LGUI SEMI    &kp SQT
              &kp TAB     &thumb_v2_TKZ LAYER_Fkey Z                         &kp X                           &kp C                           &kp V   &kp B                        &kp LSHFT                     &kp LCTRL    &lower  &kp LGUI                      &kp RCTRL          &CAPSWord_v1_TKZ RSHFT 0      &kp N                            &kp M                        &kp COMMA                        &kp DOT                           &kp FSLH  &kp PG_UP
 &magic LAYER_Magic 0                       &kp LEFT                        &kp UP                        &kp DOWN                       &kp RIGHT          &thumb_v2_TKZ LAYER_Cursor BSPC  &thumb_v2_TKZ LAYER_Fkey DEL  &kp LALT   &kp TAB  &thumb_v2_TKZ LAYER_Mouse RET  &thumb_v2_TKZ LAYER_Cursor SPACE                                   &kp PG_UP                        &kp PG_DN                     &kp C_MENU                            &kp RET  &kp PG_DN
            >;
        };

        layer_LB03_LB02 {
            bindings = <
  &none   &none   &none   &none        &none                                                                                      &none   &none   &none   &none   &none
  &none   &none   &none   &none        &none      &none                                                                   &none   &none   &none   &none   &none   &none
  &none   &none   &none   &none        &none      &none                                                                   &none   &none   &none   &none   &none   &none
  &none   &none   &none   &none        &none      &none                                                                   &none   &none   &none   &none   &none   &none
  &none   &none   &none   &none    &kp K_APP  &kp K_APP  &kp LS(TAB)    &kp TAB  &kp LG(LC(F4))   &none   &none   &none   &none   &none   &none   &none   &none   &none
  &none   &none   &none   &none  &kp LG(TAB)                &kp LEFT  &kp RIGHT   &kp LG(LC(D))   &none   &none   &none           &none   &none   &none   &none   &none
            >;
        };

        layer_LB04_LB03 {
            bindings = <
  &none   &none   &none             &none              &none                                                                                      &none   &none   &none   &none   &none
  &none   &none   &none             &none              &none      &none                                                                   &none   &none   &none   &none   &none   &none
  &none   &none   &none             &none              &none      &none                                                                   &none   &none   &none   &none   &none   &none
  &none   &none   &none             &none              &none      &none                                                                   &none   &none   &none   &none   &none   &none
  &none   &none   &none    &fullScreenApp     &fullScreenApp  &kp K_APP  &kp LS(TAB)    &kp TAB  &kp LG(LC(F4))   &none   &none   &none   &none   &none   &none   &none   &none   &none
  &none   &none   &none  &kp LG(LS(LEFT))  &kp LG(LS(RIGHT))                &kp LEFT  &kp RIGHT   &kp LG(LC(D))   &none   &none   &none           &none   &none   &none   &none   &none
            >;
        };

        layer_LB04 {
            bindings = <
  &none   &none                                       &none             &none              &none                                                                                             &none   &none   &none   &none   &none
  &none   &none                                       &none             &none              &none   &none                                                                             &none   &none   &none   &none   &none   &none
  &none   &none                                       &none             &none              &none   &none                                                                             &none   &none   &none   &none   &none   &none
  &none   &none                                       &none             &none              &none   &none                                                                             &none   &none   &none   &none   &none   &none
  &none   &none                                       &none    &fullScreenApp              &none   &none             &none              &none   &kp LA(F4)   &none   &none   &none   &none   &none   &none   &none   &none   &none
  &none   &none  &thumb_v2_TKZ LAYER_LB04_LB03 LG(LS(LEFT))  &kp LS(LG(LEFT))  &kp LG(LS(RIGHT))          &kp LG(LC(LEFT))  &kp LG(LC(RIGHT))  &kp LG(TAB)   &none   &none   &none           &none   &none   &none   &none   &none
            >;
        };

        layer_Punctuation {
            bindings = <
  &none   &none   &none   &none   &none                                                                      &none         &none   &none   &none   &none
  &none   &none   &none   &none   &none   &none                                                   &none      &none         &none   &none   &none   &none
  &none   &none   &none   &none   &none   &none                                                   &none      &none    &kp LS(N1)   &none   &none   &none
  &none   &none   &none   &none   &none   &none                                                   &none  &kp COMMA       &kp DOT   &none   &none   &none
  &none   &none   &none   &none   &none   &none   &none   &none   &none   &none   &none   &none   &none      &none  &kp LS(FSLH)   &none   &none   &none
  &none   &none   &none   &none   &none           &none   &none   &none   &none   &none   &none              &none         &none   &none   &none   &none
            >;
        };

    };
};
